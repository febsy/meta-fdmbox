## conf/layer.conf
```bitbake
# We might have a conf and classes directory, append to BBPATH
BBPATH .= ":${LAYERDIR}"

# We have recipes directories, add to BBFILES
BBFILES += "${LAYERDIR}/recipes*/*/*.bb ${LAYERDIR}/recipes*/*/*.bbappend"

BBFILE_COLLECTIONS += "meta-fdmbox"
BBFILE_PATTERN_meta-fdmbox := "^${LAYERDIR}/"
BBFILE_PRIORITY_meta-fdmbox = "7"


# This should only be incremented on significant changes that will
# # cause compatibility issues with other layers
LAYERVERSION_meta-fdmbox = "1"

LAYERDEPENDS_meta-fdmbox = "core openembedded-layer meta-maker"

LAYERSERIES_COMPAT_meta-fdmbox = "sumo"
```
